## 05-Yocto/conf/bblayers.conf
```bitbake
# POKY_BBLAYERS_CONF_VERSION is increased each time build/conf/bblayers.conf
# changes incompatibly
POKY_BBLAYERS_CONF_VERSION = "2"

BBPATH = "${TOPDIR}"
BBFILES ?= ""

BBLAYERS ?= " \
  /home/osama/Desktop/Yocto/poky/meta \
  /home/osama/Desktop/Yocto/poky/meta-poky \
  /home/osama/Desktop/Yocto/poky/meta-yocto-bsp \
  /home/osama/Desktop/Yocto/poky/meta-raspberrypi \
  /home/osama/Desktop/Yocto/poky/meta-openembedded/meta-oe \
  /home/osama/Desktop/Yocto/poky/meta-openembedded/meta-networking \
  /home/osama/Desktop/Yocto/poky/meta-openembedded/meta-python \
  /home/osama/Desktop/Yocto/poky/meta-osama \
  /home/osama/Desktop/Yocto/poky/meta-qt5 \
  "
```
